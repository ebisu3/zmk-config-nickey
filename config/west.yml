## config/west.yml
```yaml
manifest:
  remotes:
    - name: zmkfirmware
      url-base: https://github.com/zmkfirmware
    - name: caksoylar
      url-base: https://github.com/caksoylar
    - name: cormoran
      url-base: https://github.com/cormoran
  projects:
    - name: zmk
      remote: zmkfirmware
      revision: edf5c0814fd3ea202e43aad2d68fd32e882a518c
      import: app/west.yml
    - name: zmk-rgbled-widget
      remote: caksoylar
      revision: 8756cb7b8114069fa3c25c6f6c990f24988fceff
    - name: zmk-module-ble-management
      remote: cormoran
      revision: main
  self:
    path: config
```
